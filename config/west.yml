## config/west.yml
```yaml
manifest:
  remotes:
    - name: zmkfirmware
      url-base: https://github.com/shiqi-614
  projects:
    - name: zmk
      remote: shiqi-614 
      revision: main
      import: app/west.yml
  self:
    path: config
```
